## CMakeLists.txt
```
cmake_minimum_required(VERSION 3.20)

# Zephyr must be initialized before the project() command
if (NOT UNIT_TESTING)
  set(ENV{VIRTUAL_ENV} ${ZEPHYR_ENV})
  find_package(Python3)

  list(APPEND SOC_ROOT ${CMAKE_CURRENT_SOURCE_DIR})
  list(APPEND BOARD_ROOT ${CMAKE_CURRENT_SOURCE_DIR})

  find_package(Zephyr REQUIRED HINTS $ENV{ZEPHYR_BASE})
endif ()

project(nxp-cup VERSION 0.1.0)

set(CMAKE_CXX_STANDARD 20)

option(UNIT_TESTING "Enable unit testing" OFF)

include(${CMAKE_CURRENT_SOURCE_DIR}/requirements.cmake)

add_subdirectory(app)

if (UNIT_TESTING)
  enable_testing()
  add_subdirectory(${CMAKE_CURRENT_SOURCE_DIR}/tests)
else ()
  target_sources(app PRIVATE src/main.cpp src/bluetooth.cpp)

  target_include_directories(app PRIVATE src/include)

  target_link_libraries(app PRIVATE application)
  # Assigment to use the same compile options as the zephyr application
  target_link_libraries(application PRIVATE app)
endif ()
```

## prj.conf
```kconfig
CONFIG_BT=y
CONFIG_BT_PERIPHERAL=y
CONFIG_BT_SMP=y
CONFIG_BT_GATT_CLIENT=y
CONFIG_BT_DEVICE_NAME="NXPCup car demo"

CONFIG_BT_BUF_ACL_RX_SIZE=255
CONFIG_BT_BUF_ACL_TX_SIZE=251
CONFIG_BT_BUF_CMD_TX_SIZE=255
CONFIG_BT_BUF_EVT_DISCARDABLE_SIZE=255
CONFIG_BT_NSMS=y
CONFIG_BT_L2CAP_TX_MTU=247

CONFIG_LOG=y
```

## src/main.cpp
```c
#include <bluetooth.hpp>
#include <camera.hpp>
#include <control_loop.hpp>
#include <motors.hpp>
#include <stdio.h>
#include <zephyr/drivers/gpio.h>
#include <zephyr/kernel.h>

int main(void) {
  Bluetooth::init();

  Motors motors(
      [](Motors::Orientation orientation, int32_t power) {
        // Set motor power based on orientation and power level
        if(orientation == Motors::Orientation::Left) {
          printf("Setting left motor power to %d\n", power);
        } else {
          printf("Setting right motor power to %d\n", power);
        }
      },
      [](void) -> Vector2D {
        // Get current speed of the motors
        return Vector2D{0, 0}; // Placeholder for actual speed retrieval logic
      });

  LIDAR lidar([](std::vector<Obstacle> &detectedObstacles) {});

  Camera camera([](std::span<uint16_t> &buffer) {
    // Simulate capturing image data
    static uint16_t testData[] = {10, 10, 0, 0, 0, 0, 0, 10, 10, 10};
    buffer = std::span<uint16_t>(testData, sizeof(testData) / sizeof(testData[0]));
  });

  ControlLoop controlLoop(motors, camera, lidar);
  controlLoop.enable();

  while(1) {
    controlLoop.process(k_uptime_get());

    // Sleep
    Bluetooth::readMotorsSpeed();
    Bluetooth::readVehicleLocation();
    Bluetooth::readDetectedObjects();

    k_msleep(100);
  }

  return 0;
}
```

## src/bluetooth.cpp
```c
#include "bluetooth.hpp"
#include <bluetooth/services/lbs.h>
#include <bluetooth/services/nsms.h>
#include <cstring>
#include <zephyr/bluetooth/bluetooth.h>
#include <zephyr/bluetooth/conn.h>
#include <zephyr/bluetooth/gatt.h>
#include <zephyr/bluetooth/hci.h>
#include <zephyr/bluetooth/uuid.h>

enum {
  BUFFER_SIZE = 64,
};

BT_NSMS_DEF(nsmsVelocity, "Motors velcity", false, "Unknown", BUFFER_SIZE);
BT_NSMS_DEF(nsmsDetectedObjects, "Detected objects", false, "Unknown", BUFFER_SIZE);
BT_NSMS_DEF(nsmsVehicleLocation, "Vehicle location", false, "Unknown", BUFFER_SIZE);

#define DEVICE_NAME CONFIG_BT_DEVICE_NAME
#define DEVICE_NAME_LEN (sizeof(DEVICE_NAME) - 1)

static const struct bt_data ad[] = {
    BT_DATA_BYTES(BT_DATA_FLAGS, (BT_LE_AD_GENERAL | BT_LE_AD_NO_BREDR)),
};

static const struct bt_data sd[] = {
    BT_DATA(BT_DATA_NAME_COMPLETE, CONFIG_BT_DEVICE_NAME, sizeof(CONFIG_BT_DEVICE_NAME) - 1),
};

void Bluetooth::init(void) {
  // Initialize Bluetooth stack
  int err = bt_enable(NULL);
  if(err) {
    printk("Bluetooth init failed (err %d)\n", err);
    return;
  }

  printk("Bluetooth initialized\n");

  // Set up advertising
  err = bt_le_adv_start(BT_LE_ADV_CONN, ad, ARRAY_SIZE(ad), sd, ARRAY_SIZE(sd));
  if(err) {
    printk("Advertising failed to start (err %d)\n", err);
    return;
  }

  printk("Advertising started\n");
}

void Bluetooth::readMotorsSpeed() {
  char buffer[BUFFER_SIZE];
  snprintf(buffer, sizeof(buffer), "Motors speed: %d, %d", 10, 20);

  int err = bt_nsms_set_status(&nsmsVelocity, buffer);
  if(err) {
    printk("Failed to read motors speed (err %d)\n", err);
  }
}

void Bluetooth::readVehicleLocation() {
  char buffer[BUFFER_SIZE];
  snprintf(buffer, sizeof(buffer), "Vehicle location: %d %d", 50, 100);

  int err = bt_nsms_set_status(&nsmsVehicleLocation, buffer);
  if(err) {
    printk("Failed to read vehicle location (err %d)\n", err);
  }
}

void Bluetooth::readDetectedObjects() {
  char buffer[BUFFER_SIZE];
  snprintf(buffer, sizeof(buffer), "Detected objects: %s, %s", "Obstacle1", "Obstacle2");

  int err = bt_nsms_set_status(&nsmsDetectedObjects, buffer);
  if(err) {
    printk("Failed to read detected objects (err %d)\n", err);
  }
}
```
